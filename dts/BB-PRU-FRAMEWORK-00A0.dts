/*
 * Copyright (C) 2012 Texas Instruments Incorporated - http://www.ti.com/
 *
 * This program is free software; you can redistribute it and/or modify
 * it under the terms of the GNU General Public License version 2 as
 * published by the Free Software Foundation.
 */
/dts-v1/;
/plugin/;

/ {
	model = "TI AM335x BeagleBone Black";
	compatible = "ti,beaglebone", "ti,beaglebone-black";
	part-number = "BB-BONE-PRUSS";
	version = "00A0";

	fragment@0 {
		target = <&pruss>;
		#address-cells = <1>;
		#size-cells = <1>;
		__overlay__ {
			status="okay";
			compatible = "ti,am335x-pruss";
			ti,hwmods = "pruss";
			reg = <0x4a300000 0x2000>,
				  <0x4a302000 0x2000>,
				  <0x4a310000 0x3000>,
				  <0x4a320000 0x2000>,
				  <0x4a326000 0x2000>;
			reg-names = "dram0", "dram1", "shrdram2", "intc", "cfg";
			interrupts = <20 21 22 23 24 25 26 27>;
			#address-cells = <1>;
			#size-cells = <1>;
			ranges;

			pru0: pru@4a334000 {
				compatible = "ti,pru-rproc";
				reg = <0x4a334000 0x2000>,
					  <0x4a322000 0x0400>,
					  <0x4a322400 0x0100>;
				reg-names = "iram", "control", "debug";
				mboxes = <&mailbox &mbox_pru0>;
			};

			pru1: pru@4a338000 {
				compatible = "ti,pru-rproc";
				reg = <0x4a338000 0x2000>,
					  <0x4a324000 0x0400>,
					  <0x4a324400 0x0100>;
				reg-names = "iram", "control", "debug";
				mboxes = <&mailbox &mbox_pru1>;
			};

		};

	};
};
